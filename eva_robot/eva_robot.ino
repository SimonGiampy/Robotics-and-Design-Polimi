#include <MD_MAX72xx.h>
#include <ESP32Servo.h>
#include <Arduino.h>
#include <stdint.h>

typedef struct{
  int maxFrames;
  int neckBaseFrames;
  int neckBaseAngles[100];
  int neckSphereAFrames;
  int neckSphereAAngles[100];
  int neckSphereBFrames;
  int neckSphereBAngles[100];
  int leftEarFrames;
  int leftEarAngles[100];
  int rightEarFrames;
  int rightEarAngles[100];
  int leftEyebrowFrames;
  int leftEyebrowAngles[100];
  int rightEyebrowFrames;
  int rightEyebrowAngles[100];
} MovementStruct;

// --- START MOUTH ---
#define PIN_MOUTH_RED    2
#define PIN_MOUTH_GREEN  4
#define PIN_MOUTH_BLUE   12
// --- END MOUTH ---

// --- START EYES ---
#define PIN_LEFT_EYE_DATA 25
#define PIN_LEFT_EYE_CS 33
#define PIN_LEFT_EYE_CLK 32
#define PIN_RIGHT_EYE_DATA 14
#define PIN_RIGHT_EYE_CS 27
#define PIN_RIGHT_EYE_CLK 26
#define LED_MATRIX_TYPE MD_MAX72XX::FC16_HW
#define MATRIX_PER_EYE 2
#define EYES_INTENSITY 8

MD_MAX72XX leftEye = MD_MAX72XX(LED_MATRIX_TYPE, PIN_LEFT_EYE_DATA, PIN_LEFT_EYE_CLK, PIN_LEFT_EYE_CS, MATRIX_PER_EYE);
MD_MAX72XX rightEye = MD_MAX72XX(LED_MATRIX_TYPE, PIN_RIGHT_EYE_DATA, PIN_RIGHT_EYE_CLK, PIN_RIGHT_EYE_CS, MATRIX_PER_EYE);
// --- END EYES ---

// --- START NECK ---
#define PIN_NECK_BASE 21
#define PIN_NECK_SPHERE_A 22
#define PIN_NECK_SPHERE_B 23
#define NECK_BASE_START_POS 90
#define NECK_SPHERE_A_START_POS 30
#define NECK_SPHERE_B_START_POS 55

Servo neckBaseServo;
Servo neckSphereAServo;
Servo neckSphereBServo;
// --- END NECK ---

// --- START EARS ---
#define PIN_LEFT_EAR 19
#define PIN_RIGHT_EAR 18
#define LEFT_EAR_START_POS 90
#define RIGHT_EAR_START_POS 130

Servo leftEarServo;
Servo rightEarServo;
// --- END EARS ---

// --- START EYEBROWS ---
#define PIN_LEFT_EYEBROW 17
#define PIN_RIGHT_EYEBROW 16
#define LEFT_EYEBROW_START_POS 100
#define RIGHT_EYEBROW_START_POS 100

Servo leftEyebrowServo;
Servo rightEyebrowServo;
// --- END EYEBROWS ---

// --- START GLOBAL VARIABLES --
char currentEmotion = 'i';
// --- END GLOBAL VARIABLES --


void setup() {
  initMouth();
  initEars();
  initEyebrows();
  initNeck();
  initEyes();                  
  delay(500);
}

void initMouth(){
  pinMode(PIN_MOUTH_RED,  OUTPUT);
  pinMode(PIN_MOUTH_GREEN,  OUTPUT);
  pinMode(PIN_MOUTH_BLUE,  OUTPUT);
  analogWrite(PIN_MOUTH_RED, 255);
  analogWrite(PIN_MOUTH_GREEN, 0);
  analogWrite(PIN_MOUTH_BLUE, 0);
}

void setMouthColor(uint8_t R, uint8_t G, uint8_t B){
  analogWrite(PIN_MOUTH_RED, R);
  analogWrite(PIN_MOUTH_GREEN, G);
  analogWrite(PIN_MOUTH_BLUE, B);
}

void initEars(){
  leftEarServo.attach(PIN_LEFT_EAR);
  rightEarServo.attach(PIN_RIGHT_EAR);
  leftEarServo.write(LEFT_EAR_START_POS);
  rightEarServo.write(RIGHT_EAR_START_POS);
}

void initEyebrows(){
    leftEyebrowServo.attach(PIN_LEFT_EYEBROW);
    rightEyebrowServo.attach(PIN_RIGHT_EYEBROW);
    leftEyebrowServo.write(LEFT_EYEBROW_START_POS);
    rightEyebrowServo.write(RIGHT_EYEBROW_START_POS);
}

void initNeck(){
    neckBaseServo.attach(PIN_NECK_BASE);
    neckSphereAServo.attach(PIN_NECK_SPHERE_A);
    neckSphereBServo.attach(PIN_NECK_SPHERE_B);
    neckBaseServo.write(NECK_BASE_START_POS);
    neckSphereAServo.write(NECK_SPHERE_A_START_POS);
    neckSphereBServo.write(NECK_SPHERE_B_START_POS);
}

void initEyes(){
    leftEye.begin();
    rightEye.begin();
    leftEye.clear();
    rightEye.clear();
    leftEye.control(MD_MAX72XX::INTENSITY, EYES_INTENSITY);
    rightEye.control(MD_MAX72XX::INTENSITY, EYES_INTENSITY);
}

uint8_t calm[][2][16] = {
  {{0x0, 0x0, 0x7E, 0xFF, 0xFF, 0xFF, 0xE1, 0xE1, 0xE1, 0xE1, 0xFF, 0xFF, 0xFF, 0x7E, 0x0, 0x0},{0x0, 0x0, 0x7E, 0xFF, 0xFF, 0xFF, 0xE1, 0xE1, 0xE1, 0xE1, 0xFF, 0xFF, 0xFF, 0x7E, 0x0, 0x0}},
  {{0x0, 0x0, 0x7E, 0xFF, 0xFF, 0xFF, 0xE1, 0xE1, 0xE1, 0xE1, 0xFF, 0xFF, 0xFF, 0x7E, 0x0, 0x0},{0x0, 0x0, 0x7E, 0xFF, 0xFF, 0xFF, 0xE1, 0xE1, 0xE1, 0xE1, 0xFF, 0xFF, 0xFF, 0x7E, 0x0, 0x0}},
  {{0x0, 0x0, 0x3C, 0x7E, 0x7E, 0x7E, 0x62, 0x62, 0x62, 0x62, 0x7E, 0x7E, 0x7E, 0x3C, 0x0, 0x0},{0x0, 0x0, 0x3C, 0x7E, 0x7E, 0x7E, 0x62, 0x62, 0x62, 0x62, 0x7E, 0x7E, 0x7E, 0x3C, 0x0, 0x0}},
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  {{0x0, 0x0, 0x7E, 0xFF, 0xFF, 0xFF, 0xE1, 0xE1, 0xE1, 0xE1, 0xFF, 0xFF, 0xFF, 0x7E, 0x0, 0x0},{0x0, 0x0, 0x7E, 0xFF, 0xFF, 0xFF, 0xE1, 0xE1, 0xE1, 0xE1, 0xFF, 0xFF, 0xFF, 0x7E, 0x0, 0x0}}
};

MovementStruct idleMovements = {
  // maxFrames
  60,
  // neckBaseFrames
  60,
  // neckBaseAngles
  {40, 40, 40, 40, 40, 40, 40, 40, 40, 40, 40, 45, 50,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 50, 45},
  // neckSphereAFrames
  0,
  // neckSphereAAngles
  {},
  // neckSphereBFrames
  54,
  // neckSphereBAngles
  {55, 55, 55, 57, 59, 61, 63, 65, 67, 69, 69, 69, 67,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 55, 55},
  // leftEarFrames
  27,
  // leftEarAngles
  {80, 80, 80, 80, 80, 80, 80, 80, 80, 80, 80, 150, 150, 150, 150, 80, 80, 80, 80, 150, 150, 150, 150, 80, 80, 80, 80},
  // rightEarFrames
  27,
  // rightEarAngles
  {150, 150, 150, 150, 150, 150, 150, 150, 150, 150, 150, 80, 80, 80, 80, 150, 150, 150, 150, 80, 80, 80, 80, 150, 150, 150, 150},
  // leftEyebrowFrames
  0,
  // leftEyebrowAngles
  {},
  // rightEyebrowFrames
  0,
  // rightEyebrowAngles
  {}
};

void loop() {
  char currentAnimation = currentEmotion;
  switch(currentAnimation){
    case 'i':
      for(int frame = 0; frame < idleMovements.maxFrames; frame++){
        neckBaseServo.write(idleMovements.neckBaseAngles[frame%idleMovements.neckBaseFrames]);
        //neckSphereAServo.write(idleMovements.neckSphereAAngles[frame%idleMovements.neckSphereAFrames]);
        neckSphereBServo.write(idleMovements.neckSphereBAngles[frame%idleMovements.neckSphereBFrames]);
        leftEarServo.write(idleMovements.leftEarAngles[frame%idleMovements.leftEarFrames]);
        rightEarServo.write(idleMovements.rightEarAngles[frame%idleMovements.rightEarFrames]);
        for(int i=0; i < 16; i++){
          rightEye.setColumn(i, calm[frame%58][0][i]);
          leftEye.setColumn(i, calm[frame%58][1][i]);
        }
        unsigned long time_now = millis();
        while(millis() < time_now + 75){
          //wait approx. 100 ms
        }
        if(currentAnimation != currentEmotion){
          break;
        }
      }
      break;
  }
}